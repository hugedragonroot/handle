#include "lcd_ext.h"
#include "lcd_drv.h"
#include "delay.h"
#include "power_control.h"

#if !USING_LED_POINT_DISPLAY 
//LCD的显存
//存放格式如下.
//[0]0 1 2 3 ... 127	
//[1]0 1 2 3 ... 127	
//[2]0 1 2 3 ... 127	
//[3]0 1 2 3 ... 127	
//[4]0 1 2 3 ... 127	
//[5]0 1 2 3 ... 127	
//[6]0 1 2 3 ... 127	
//[7]0 1 2 3 ... 127 		   
#define  LCD_WIDTH 	128
#define  LCD_HIGH 	64
volatile static u8 lcdGram[LCD_WIDTH][LCD_HIGH/8];

const unsigned char ascii_table_8x16[95][16];
const unsigned char ascii_table_5x8[95][5];

//写指令到 LCD 模块
void transfer_command(uint8_t data)
{
	uint8_t i;
	LCD_CS_OFF();
	LCD_RS_OFF();
	for(i=0;i<8;i++)
	{
		LCD_CLK_OFF();
		if(data&0x80) 
			LCD_DAT_ON();
		else 
			LCD_DAT_OFF();
		LCD_CLK_ON();
		data<<=1;
	}
	LCD_CS_ON();
}

//写数据到 LCD 模块
void transfer_data(uint8_t data)
{
	uint8_t i;
	LCD_CS_OFF();
	LCD_RS_ON();
	for(i=0;i<8;i++)
	{
		LCD_CLK_OFF();
		if(data&0x80) 
			LCD_DAT_ON();
		else 
			LCD_DAT_OFF();
		LCD_CLK_ON();
		data<<=1;
	}
	LCD_CS_ON();
}


void lcd_PowerOff(void)
{
	paraInit();

	clear_screen();
	display_string_8x16(0,16,0,(uint8_t*)"DRIVER POWEROFF!");
	lcd_refreshGram();
	BTdisconnect();
	// delay_ms(1500);			
	delay_ms(1000);			

	powerOFF();//下板电源关

	clear_screen();
	lcd_initIO_PwrOff();

}

void lcd_PowerOn(void)
{	
	char str[50];
	lcd_initIO();	
	lcd_init();
	// display_init();

	powerON();//下板电源开
	sprintf(str,"SOFTWARE_VERSION     V%d.%d.%d",SOFTWARE_VER0,SOFTWARE_VER1,SOFTWARE_VER2);
	display_string_8x16(0,16,0,(uint8_t*)str);
	lcd_refreshGram();
	BTEnterStandby();
	delay_ms(1000);	
	clear_screen();	
	lcd_refreshGram();

	paraInit();
	// delay_ms(10);
	// CANSubInit();
	
	
}



//LCD 模块初始化
void lcd_init(void)
{
	LCD_RST_OFF(); //低电平复位
	delay_ms(100);
	LCD_RST_ON(); //复位完毕
	delay_ms(100);
	transfer_command(0xe2); //软复位
	delay_ms(50);
	transfer_command(0x2c); //软复位
	delay_ms(50);
	transfer_command(0x2e); //软复位	
	delay_ms(50);
	transfer_command(0x2f); //打开内部升压
	delay_ms(500);
	transfer_command(0x24);  /*粗调对比度，可设置范围0x20～0x27*/
	transfer_command(0x81);  /*微调对比度*/
	transfer_command(0x1b);  /*0x1a,微调对比度的值，可设置范围0x00～0x3f*/
	transfer_command(0xa2);  /*1/9偏压比（bias）*/
	transfer_command(0xc0);  /*行扫描顺序：从上到下*/
	transfer_command(0xa1);  /*列扫描顺序：从左到右*/
	transfer_command(0x40);  /*起始行：第一行开始*/
	transfer_command(0xaf);  /*开显示*/
	clear_screen();

	
}

void lcd_address(uint8_t page,uint8_t column)
{
	column=column-1; //我们平常所说的第1列，在LCD驱动IC里是第0列。所以在这里减去1.
	page=page-1;
	transfer_command(0xb0+page); //设置页地址。每页8行。一个画面的64行被分成8个页。平常所说的第1页，在LCD驱动IC里是第0页，所以减去1
	transfer_command(((column>>4)&0x0f)+0x10); //设置列地址的高 4 位
	transfer_command(column&0x0f); //设置列地址的低 4 位
}



//更新显存到LCD		 
void lcd_refreshGram(void)
{
	uint8_t i,j;
	for(i=0;i<(LCD_HIGH/8);i++)
	{
		lcd_address(1+i,1);
		for(j=0;j<LCD_WIDTH;j++)
		{
			transfer_data(lcdGram[j][i]);
		}
	}	
}


//全屏清屏
void lcd_clear(void)
{
	uint8_t i,j;
	for(i=0;i<(LCD_HIGH/8);i++)
	{
//		lcd_address(1+i,1);
		for(j=0;j<LCD_WIDTH;j++)
		{
			lcdGram[j][i]=0x00;
//			transfer_data(0x00);
		}
	}
}



//画点 
//x:0~191
//y:0~63
//t:1 填充 0,清空				   
void lcd_drawPoint(u8 x,u8 y,u8 t)
{
	u8 pos,bx,temp=0;
	if(x>LCD_WIDTH-1||y>LCD_HIGH-1)return;//超出范围了.
	pos=y/8;
	bx=y%8;
	temp=1<<(bx);
	if(t)lcdGram[x][pos]|=temp;
	else lcdGram[x][pos]&=~temp;	    
}
//读点 
//x:0~191
//y:0~63
u8 lcd_readPoint(u8 x,u8 y)
{
	u8 pos,bx,temp=0x00;
	//x = LCD_WIDTH-1-x;
	y = LCD_HIGH-1-y;
	pos=y/8;
	bx=y%8;
	temp=1<<bx;
  if(temp&lcdGram[x][pos]) return 1;
	return 0;
}
//x1,y1,x2,y2 填充区域的对角坐标
//确保x1<=x2;y1<=y2 0<=x1<=127 0<=y1<=63	 	 
//dot:0,清空;1,填充	  
void lcd_fill(u8 x1,u8 y1,u8 x2,u8 y2,u8 dot)  
{  
	u8 x,y;  
	for(x=x1;x<=x2;x++)
		for(y=y1;y<=y2;y++)
			lcd_drawPoint(x,y,dot);											    
//	oled_refreshGram();//更新显示
}
//在指定位置显示一个字符,包括部分字符
//x:0~191
//y:0~63
//f_w:字宽
//f_h:字高
//mode:1,反白显示;0,正常显示				 
void lcd_showChar(u8 x,u8 y,u8 chr,u8 f_w,u8 f_h,u8 mode)
{      			    
	u8 temp,t,t1,n;

	u8 csize = f_h/8;
	
	chr=chr-' ';//得到偏移后的值		 

	for(n=0;n<csize;n++)
	{
		for(t=0;t<f_w;t++)
		{   
			if(f_w==5&&f_h==8)temp=ascii_table_5x8[chr][t+f_w*n];		//调用0508ascii字体
			else if(f_w==8&&f_h==16)temp=ascii_table_8x16[chr][t+f_w*n];	//调用0816ascii字体
//		else if(f_w==12&&f_h==24)temp=asc2_1224[chr][t];//调用1224ascii字体
			else return;	//没有的字库
			for(t1=0;t1<8;t1++)
			{
				if(temp&0x01)
					lcd_drawPoint(x,y,!mode);
				else 
					lcd_drawPoint(x,y,mode);
				temp >>=1;
				y++;
			} 
			y=y-8;
			x++;			
		}
		x = x - f_w;
		y = y +8;
	}		
}
//m^n函数
u32 mypow(u8 m,u8 n)
{
	u32 result=1;	 
	while(n--)result*=m;    
	return result;
}				  
//显示2个数字
//x,y :起点坐标	 
//len :数字的位数
//f_w:字宽
//f_h:字高
//mode:模式	0,填充模式;1,叠加模式
//num:数值(0~4294967295);	 		  
void lcd_showNum(u8 x,u8 y,u32 num,u8 len,u8 f_w,u8 f_h)
{         	
	u8 t,temp;
	u8 enshow=0;						   
	for(t=0;t<len;t++)
	{
		temp=(num/mypow(10,len-t-1))%10;
		if(enshow==0&&t<(len-1))
		{
			if(temp==0)
			{
				lcd_showChar(x+(f_w)*t,y,' ',f_w,f_h,1);
				continue;
			}
			else 
				enshow=1; 
		}
	 	lcd_showChar(x+(f_w)*t,y,temp+'0',f_w,f_h,1); 
	}
} 
//显示字符串
//x,y:起点坐标  
//f_w:字宽
//f_h:字高
//*p:字符串起始地址 
void lcd_showString(u8 x,u8 y,const u8 *p,u8 f_w,u8 f_h,u8 re)
{	
    while((*p<='~')&&(*p>=' '))//判断是不是非法字符!
    {       
        if(x>(LCD_WIDTH-(f_w))){x=0;y+=f_h;}
        if(y>(LCD_HIGH-f_h)){y=x=0;lcd_clear();}
        lcd_showChar(x,y,*p,f_w,f_h,re);	 
        x+=f_w;
        p++;
    }  
	
}
//显示图片
//x,y:起点坐标  
//p_w:图片宽（单位像素）
//p_h:图片高（单位像素）
//*p:图片起始地址 
void lcd_showPicture(u8 x,u8 y,const u8 *p,u8 p_w,u8 p_h)
{	
	u8 temp,i,col,row;

	u8 width=p_w;
	u8 high=p_h;
	u8 exp_col_bytes;
	u8 act_col_bytes;
	
	if(x+p_w>LCD_WIDTH)width=LCD_WIDTH-p_w;//实际显示宽度

	if(y+p_h>LCD_HIGH)high=LCD_HIGH-p_h;//实际显示高度
	exp_col_bytes=(p_h/8+((p_h%8)?1:0));//显示一列的字节数
	act_col_bytes=(high/8+((high%8)?1:0));//实际显示一列的字节数
	
	for(col=0;col<act_col_bytes;col++)
	{
		for(row=0;row<width;row++)
		{
			temp = p[col*width+row];
			for(i=0;i<8;i++)
			{
				if(temp&0x01)lcd_drawPoint(x,y,1);
				else lcd_drawPoint(x,y,0);
				temp>>=1;
				y++;
			}
			x++;
			y = y-8;
		}
		x = x-width;
		y = y+8;
		
	}
	
//	for(row=0;row<width;row++)//列++
//	{
//		for(col=0;col<act_col_bytes;col++)//显示一列
//		{   
//			temp = p[col+row*exp_col_bytes];
//			for(i=0;i<8;i++)
//			{
//				if(temp&0x01)lcd_drawPoint(x,y,1);
//				else lcd_drawPoint(x,y,0);
//				temp>>=1;
//				y++;
//				if((y-y0)==high)
//				{
//					y=y0;
//					x++;
//					break;
//				}		
//			} 
//		}
//	}		
}



//全屏清屏
void clear_screen(void)
{
	lcd_clear();
}

//部分清屏
void clear_graphic(uint8_t column,uint8_t page,uint8_t w,uint8_t h)
{
	
	lcd_fill(column,page,column+w,page+h,0);
	
}




//==================display a piture of 128*64 dots================



void display_string_8x16(uint8_t column,uint8_t page,uint8_t reverse,uint8_t *text)
{
	
	lcd_showString(column,page,text,8,16,reverse);

}


//显示一串 5x8 点阵的字符串
//括号里的参数分别为（页，列，是否反显，数据指针）
void display_string_5x8(uint8_t column,uint8_t page,uint8_t reverse,uint8_t *text)
{
	lcd_showString(column,page,text,5,8,reverse);
}


//x,y：屏幕坐标，(0,0)--(191,63)；
//w,h：图像宽度、高度；
void display_graphic(uint8_t column,uint8_t page,uint8_t w,uint8_t h,const uint8_t *dp)
{

	lcd_showPicture(column,page,dp,w,h);
}

//水平居中显示
void center_display_string(uint8_t page,uint8_t reverse,uint8_t *text){
	display_string_8x16((LCD_WIDTH - strlen((char *)text)*8)/2,page,reverse,text);
}


const unsigned char ascii_table_8x16[95][16]={
//粗体 8x16 点阵的 ASCII 码的点阵数据，从"JLX-GB2312"型号的字库 IC 中读出来的国标的。
0x00,0x00,0x00,0x00, 0x00,0x00,0x00,0x00, 0x00,0x00,0x00,0x00, 0x00,0x00,0x00,0x00, //- -
0x00,0x00,0x38,0xFC, 0xFC,0x38,0x00,0x00, 0x00,0x00,0x00,0x0D, 0x0D,0x00,0x00,0x00, //-!-
0x00,0x0E,0x1E,0x00, 0x00,0x1E,0x0E,0x00, 0x00,0x00,0x00,0x00, 0x00,0x00,0x00,0x00, //-"-
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0x08,0x0C,0x04,0x0C, 0x08,0x0C,0x04,0x00, 0x00,0x00,0x00,0x00, 0x00,0x00,0x00,0x00, //-~-
};

const unsigned char ascii_table_5x8[95][5]={
/*全体 ASCII 列表:5x8 点阵*/
0x00,0x00,0x00,0x00,0x00,//- - //space
0x00,0x00,0x4f,0x00,0x00,//-!-
0x00,0x07,0x00,0x07,0x00,//-"-
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0x04,0x02,0x02,0x02,0x01,//-~-
};
#endif


